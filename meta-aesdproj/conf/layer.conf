## meta-aesdproj/conf/layer.conf
```bitbake
# We have a conf and classes directory, add to BBPATH
BBPATH .= ":${LAYERDIR}"

# We have recipes-* directories, add to BBFILES
BBFILES += "${LAYERDIR}/recipes-*/*/*.bb \
            ${LAYERDIR}/recipes-*/*/*.bbappend"

BBFILE_COLLECTIONS += "meta-aesdproj"
BBFILE_PATTERN_meta-aesdproj = "^${LAYERDIR}/"
BBFILE_PRIORITY_meta-aesdproj = "10"

LAYERDEPENDS_meta-aesdproj = "core"
LAYERSERIES_COMPAT_meta-aesdproj = "scarthgap"
```
